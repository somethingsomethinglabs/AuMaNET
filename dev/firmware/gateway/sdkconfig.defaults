## dev/firmware/gateway/sdkconfig.defaults
```kconfig
CONFIG_AUMANET_GATEWAY=y
CONFIG_WIFI_MORSE_AU_CHANNELISATION_2024=y
CONFIG_LWIP_IP_FORWARD=y
CONFIG_LWIP_IPV4_NAPT=n
CONFIG_LWIP_IPV6=n
CONFIG_LWIP_IP4_FRAG=n
CONFIG_LWIP_IP4_REASSEMBLY=n
CONFIG_LWIP_TCPIP_TASK_STACK_SIZE=8192
CONFIG_ESP_MAIN_TASK_STACK_SIZE=16384
CONFIG_BOOTLOADER_APP_ROLLBACK_ENABLE=y
CONFIG_BOOTLOADER_APP_ANTI_ROLLBACK=n
CONFIG_MBEDTLS_GCM_C=y
CONFIG_MBEDTLS_HKDF_C=y
CONFIG_MBEDTLS_ECDH_C=y

CONFIG_PARTITION_TABLE_CUSTOM_FILENAME="gateway/partitions-ota.csv"
CONFIG_PARTITION_TABLE_FILENAME="gateway/partitions-ota.csv"
```

## dev/firmware/main/Kconfig.projbuild
```kconfig
menu "AuMaNET isolated bench"
config AUMANET_RF_ENABLED
    bool "Enable manually provisioned HaLow bench transport"
    default n
    help
        Requires verified module/antenna and regional operating profile.
        Disabled builds never boot the radio or start a wireless network.
config AUMANET_NODE_B
    bool "Build node B (station); otherwise node A (AP)"
    default n
config AUMANET_GATEWAY
    bool "Experimental physically provisioned phone AP and signed gateway"
    default n
    help
        Requires tools/build.sh explicit gateway mode and its pinned lwIP overlay.
        Default trust is absent. USB provisioning and signed, expiring grants
        are required before any phone traffic is forwarded. Not a release mode.
config AUMANET_PRIVATE_BOOTSTRAP
    bool "PRIVATE USB bootstrap: import legacy compiled link credentials"
    default n
    depends on AUMANET_GATEWAY
    help
        Never publish this image. Generic OTA images read retained private NVS
        and must not include a private compiled SSID/passphrase fallback.
config AUMANET_SSID
    string "Isolated HaLow bench SSID"
    default "AuMaNET-bench"
config AUMANET_PSK
    string "Private WPA3 bench passphrase"
    default ""
config AUMANET_CHANNEL
    int "Approved S1G channel number"
    default 0
config AUMANET_OPCLASS
    int "Approved S1G operating class"
    default 0
config AUMANET_TX_DBM
    int "Bench maximum conducted TX power (integer dBm)"
    range 1 24
    default 1
endmenu
```

## dev/firmware/sdkconfig.defaults
```kconfig
CONFIG_IDF_TARGET="esp32s3"
CONFIG_BT_ENABLED=y
CONFIG_BT_NIMBLE_ENABLED=y
CONFIG_BT_NIMBLE_MAX_CONNECTIONS=1
CONFIG_BT_NIMBLE_HOST_TASK_STACK_SIZE=6144
CONFIG_BT_NIMBLE_ROLE_CENTRAL=n
CONFIG_BT_NIMBLE_ROLE_OBSERVER=n
CONFIG_BT_NIMBLE_ATT_PREFERRED_MTU=247
CONFIG_ESPTOOLPY_FLASHSIZE_8MB=y
CONFIG_PARTITION_TABLE_CUSTOM=y
CONFIG_PARTITION_TABLE_CUSTOM_FILENAME="partitions.csv"
CONFIG_PARTITION_TABLE_FILENAME="partitions.csv"
CONFIG_ESP_CONSOLE_USB_SERIAL_JTAG=y
CONFIG_FREERTOS_HZ=1000
CONFIG_HALOW_PS_MODE=n
CONFIG_HALOW_COUNTRY_CODE="??"
CONFIG_MM_RESET_N=1
CONFIG_MM_WAKE=2
CONFIG_MM_BUSY=5
CONFIG_MM_SPI_SCK=7
CONFIG_MM_SPI_MOSI=9
CONFIG_MM_SPI_MISO=8
CONFIG_MM_SPI_CS=4
CONFIG_MM_SPI_IRQ=3
CONFIG_MM_BCF_FILE="bcf_fgh100mhaamd.bin"
CONFIG_MM_CHIP_MM6108=y
CONFIG_AUMANET_RF_ENABLED=n
```
