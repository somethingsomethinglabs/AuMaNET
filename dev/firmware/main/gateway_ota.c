/* SPDX-License-Identifier: Apache-2.0. Bounded inactive-app update runtime. */
#include "sdkconfig.h"
#if CONFIG_ESP_MAIN_TASK_STACK_SIZE < 16384
#error "Gateway OTA receipt verification requires at least 16384 bytes of main-task stack"
#endif
#include "gateway_ota.h"
#include "gateway_ota_build.h"
#include "gateway_boot_crypto.h"
#include "link_credentials.h"
#include "aumanet_gateway.h"
#include "aumanet_ota.h"
#include "ota_publisher.h"
#include "esp_ota_ops.h"
#include "esp_app_desc.h"
#include "esp_app_format.h"
#include "esp_image_format.h"
#include "esp_timer.h"
#include "esp_system.h"
#include "nvs.h"
#include "mbedtls/ecdh.h"
#include "mbedtls/gcm.h"
#include "mbedtls/hkdf.h"
#include "mbedtls/sha256.h"
#include "lwip/sockets.h"
#include "lwip/inet.h"
#include "freertos/FreeRTOS.h"
#include "freertos/task.h"
#include <stdatomic.h>
#include <string.h>
#include <unistd.h>
#include <stdio.h>

struct ota_receipt {uint32_t version,offset;uint8_t session[16],manifest[384],signature[72];uint32_t signature_bytes;};
static struct gateway_ota_config config;
static struct ao_context engine;
static mbedtls_ecp_keypair ephemeral_key;
static int udp=-1;
static esp_ota_handle_t handle;
static const esp_partition_t *destination;
static struct ota_receipt staged,running_receipt;
static atomic_bool pending_boot,confirmed_boot;
static atomic_int known_boot_state=255;
static bool receipt_ready,started,upload_open,running_identity_ready;
static uint64_t reboot_at;
static uint32_t running_bytes;static uint8_t running_hash[32];
static uint64_t now_ms(void){int64_t v=esp_timer_get_time();return v<0?UINT64_MAX:(uint64_t)v/1000;}
static uint32_t u32(const uint8_t*p){return (uint32_t)p[0]<<24|(uint32_t)p[1]<<16|(uint32_t)p[2]<<8|p[3];}
static void put32(uint8_t*p,uint32_t n){for(unsigned i=0;i<4;i++)p[3-i]=(uint8_t)(n>>(8*i));}
static uint64_t now_cb(void*unused){(void)unused;return now_ms();}
static int current(void *unused){(void)unused;return config.current&&config.current()==1;}
static uint32_t generation_cb(void*unused){(void)unused;return config.generation?config.generation():0;}
static int same_authority(void){return current(NULL)&&generation_cb(NULL)&&engine.authority_generation==generation_cb(NULL);}
static int random_cb(void*unused,uint8_t*p,size_t n){(void)unused;return gb_crypto_random(p,n);}
static int random_mbed(void*unused,uint8_t*p,size_t n){return random_cb(unused,p,n)?0:MBEDTLS_ERR_ECP_RANDOM_FAILED;}
static int hash_cb(void*unused,const uint8_t*p,size_t n,uint8_t out[32]){(void)unused;return gb_crypto_hash(p,n,out);}
static int owner_verify(void*unused,const uint8_t*p,size_t n,const uint8_t*s,size_t z){(void)unused;return current(NULL)&&ag_crypto_verify(config.owner_der,config.owner_bytes,config.owner_pin,p,n,s,z)&&current(NULL);}
static int publisher_verify(void*unused,const uint8_t*p,size_t n,const uint8_t*s,size_t z){(void)unused;static const uint8_t domain[]="AuMaNET firmware artifact v1";uint8_t bytes[sizeof domain+384];if(n!=384)return 0;memcpy(bytes,domain,sizeof domain);memcpy(bytes+sizeof domain,p,n);return ag_crypto_verify(ota_publisher_der,sizeof ota_publisher_der,ota_publisher_pin,bytes,sizeof bytes,s,z);}
static int sign_cb(void*unused,const uint8_t*p,size_t n,uint8_t s[72],size_t*z){(void)unused;return gb_crypto_sign(p,n,s,z);}
static int ephemeral_cb(void*unused,uint8_t p[65]){(void)unused;size_t n=0;mbedtls_ecp_keypair_free(&ephemeral_key);mbedtls_ecp_keypair_init(&ephemeral_key);return !mbedtls_ecp_gen_key(MBEDTLS_ECP_DP_SECP256R1,&ephemeral_key,random_mbed,NULL)&&!mbedtls_ecp_point_write_binary(&ephemeral_key.MBEDTLS_PRIVATE(grp),&ephemeral_key.MBEDTLS_PRIVATE(Q),MBEDTLS_ECP_PF_UNCOMPRESSED,&n,p,65)&&n==65;}
static int derive_cb(void*unused,const uint8_t p[65],const uint8_t salt[32],uint8_t keys[72]){(void)unused;mbedtls_ecp_point peer;mbedtls_mpi z;uint8_t secret[32];static const uint8_t info[]="AuMaNET OTA session keys v1";int ok=0;mbedtls_ecp_point_init(&peer);mbedtls_mpi_init(&z);if(!mbedtls_ecp_point_read_binary(&ephemeral_key.MBEDTLS_PRIVATE(grp),&peer,p,65)&&!mbedtls_ecp_check_pubkey(&ephemeral_key.MBEDTLS_PRIVATE(grp),&peer)&&!mbedtls_ecdh_compute_shared(&ephemeral_key.MBEDTLS_PRIVATE(grp),&z,&peer,&ephemeral_key.MBEDTLS_PRIVATE(d),random_mbed,NULL)&&!mbedtls_mpi_write_binary(&z,secret,sizeof secret))ok=!mbedtls_hkdf(mbedtls_md_info_from_type(MBEDTLS_MD_SHA256),salt,32,secret,32,info,sizeof info,keys,72);memset(secret,0,sizeof secret);mbedtls_mpi_free(&z);mbedtls_ecp_point_free(&peer);mbedtls_ecp_keypair_free(&ephemeral_key);mbedtls_ecp_keypair_init(&ephemeral_key);return ok;}
static int gcm_cb(void*unused,int encrypt,const uint8_t key[32],const uint8_t nonce[12],const uint8_t*aad,size_t an,const uint8_t*in,size_t n,uint8_t*out,uint8_t tag[16]){(void)unused;mbedtls_gcm_context g;mbedtls_gcm_init(&g);int e=mbedtls_gcm_setkey(&g,MBEDTLS_CIPHER_ID_AES,key,256);if(!e)e=encrypt?mbedtls_gcm_crypt_and_tag(&g,MBEDTLS_GCM_ENCRYPT,n,nonce,12,aad,an,in,out,16,tag):mbedtls_gcm_auth_decrypt(&g,n,nonce,12,aad,an,tag,16,in,out);mbedtls_gcm_free(&g);return e==0;}
static int layout_ready(void){const esp_partition_t*a=esp_partition_find_first(ESP_PARTITION_TYPE_APP,ESP_PARTITION_SUBTYPE_APP_OTA_0,NULL),*b=esp_partition_find_first(ESP_PARTITION_TYPE_APP,ESP_PARTITION_SUBTYPE_APP_OTA_1,NULL),*d=esp_partition_find_first(ESP_PARTITION_TYPE_DATA,ESP_PARTITION_SUBTYPE_DATA_OTA,NULL),*f=esp_partition_find_first(ESP_PARTITION_TYPE_APP,ESP_PARTITION_SUBTYPE_APP_FACTORY,NULL);return a&&b&&d&&f&&a->address==0x310000&&b->address==0x550000&&a->size==AO_SLOT_BYTES&&b->size==AO_SLOT_BYTES&&d->address==0x790000&&d->size==0x2000&&f->address==0x10000&&f->size==0x300000;}
static void abort_cb(void*unused){(void)unused;if(upload_open){esp_ota_abort(handle);upload_open=false;}handle=0;destination=NULL;memset(&staged,0,sizeof staged);}
static int begin_cb(void*unused,const uint8_t manifest[384],const uint8_t*sig,size_t sigbytes,const uint8_t sid[16]){(void)unused;if(!layout_ready()||!running_identity_ready||atomic_load(&pending_boot)||!same_authority()||upload_open)return 0;destination=esp_ota_get_next_update_partition(NULL);const esp_partition_t*run=esp_ota_get_running_partition();if(!destination||destination==run||destination->type!=ESP_PARTITION_TYPE_APP||(destination->subtype!=ESP_PARTITION_SUBTYPE_APP_OTA_0&&destination->subtype!=ESP_PARTITION_SUBTYPE_APP_OTA_1)||destination->size!=AO_SLOT_BYTES)return 0;memset(&staged,0,sizeof staged);staged.version=1;staged.offset=destination->address;staged.signature_bytes=(uint32_t)sigbytes;memcpy(staged.manifest,manifest,384);memcpy(staged.signature,sig,sigbytes);memcpy(staged.session,sid,16);if(!same_authority()||esp_ota_begin(destination,OTA_WITH_SEQUENTIAL_WRITES,&handle)!=ESP_OK){abort_cb(NULL);return 0;}upload_open=true;return 1;}
static int embedded_checked(const uint8_t*p,size_t n){if(n<0x120+sizeof(struct gateway_ota_build))return 0;const esp_image_header_t*h=(const esp_image_header_t*)p;const esp_app_desc_t*a=(const esp_app_desc_t*)(p+sizeof *h+sizeof(esp_image_segment_header_t));const struct gateway_ota_build*m=(const struct gateway_ota_build*)(p+0x120);return h->magic==ESP_IMAGE_HEADER_MAGIC&&h->chip_id==ESP_CHIP_ID_ESP32S3&&(p[3]>>4)==3&&a->magic_word==ESP_APP_DESC_MAGIC_WORD&&!memcmp(a->version,staged.manifest+124,32)&&!memcmp(m->magic,"AUMBD1\0\0",8)&&m->role==config.role&&m->layout==1&&!memcmp(m->country,"AU",2)&&m->power==24&&!m->private_bootstrap&&m->channel==staged.manifest[13]&&m->flags==staged.manifest[39]&&!staged.manifest[38]&&!memcmp(m->version,staged.manifest+124,32)&&!memcmp(m->commit,staged.manifest+72,20)&&!memcmp(m->ref,staged.manifest+156,128)&&!memcmp(m->build,staged.manifest+284,64)&&!memcmp(m->profile,staged.manifest+348,32);}
static int write_cb(void*unused,uint32_t offset,const uint8_t*p,size_t n){(void)unused;return upload_open&&same_authority()&&(offset||embedded_checked(p,n))&&esp_ota_write(handle,p,n)==ESP_OK;}
static int partition_hash(const esp_partition_t*p,uint32_t bytes,uint8_t out[32]){uint8_t b[1024];mbedtls_sha256_context sha;int ok=1;mbedtls_sha256_init(&sha);if(mbedtls_sha256_starts(&sha,0))ok=0;for(uint32_t at=0;ok&&at<bytes;){size_t n=bytes-at>sizeof b?sizeof b:bytes-at;if(esp_partition_read(p,at,b,n)!=ESP_OK||mbedtls_sha256_update(&sha,b,n))ok=0;at+=(uint32_t)n;}if(ok&&mbedtls_sha256_finish(&sha,out))ok=0;mbedtls_sha256_free(&sha);return ok;}
static int finish_cb(void*unused,const uint8_t manifest[384]){(void)unused;uint8_t hash[32];if(!upload_open||!same_authority()||!partition_hash(destination,u32(manifest+16),hash)||memcmp(hash,manifest+40,32))return 0;esp_err_t e=esp_ota_end(handle);upload_open=false;handle=0;if(e!=ESP_OK||!same_authority())return 0;esp_image_metadata_t metadata={0};esp_partition_pos_t pos={.offset=destination->address,.size=destination->size};return esp_image_verify(ESP_IMAGE_VERIFY_SILENT,&pos,&metadata)==ESP_OK&&metadata.image_len==u32(manifest+16)&&same_authority();}
static const char*receipt_key(uint32_t offset){return offset==0x310000?"ota0":offset==0x550000?"ota1":NULL;}
static int save_receipt(void){const char*key=receipt_key(staged.offset);if(!key)return 0;nvs_handle_t h;esp_err_t e=nvs_open("amn_update1",NVS_READWRITE,&h);if(e!=ESP_OK)return 0;e=nvs_set_blob(h,key,&staged,sizeof staged);if(e==ESP_OK)e=nvs_commit(h);struct ota_receipt back;size_t n=sizeof back;if(e==ESP_OK&&(nvs_get_blob(h,key,&back,&n)!=ESP_OK||n!=sizeof back||memcmp(&back,&staged,sizeof back)))e=ESP_FAIL;nvs_close(h);return e==ESP_OK;}
static int activate_cb(void*unused,const uint8_t sid[16],const uint8_t artifact[32]){(void)unused;uint8_t id[32];if(!destination||upload_open||!same_authority()||memcmp(staged.session,sid,16)||!gb_crypto_hash(staged.manifest,384,id)||memcmp(id,artifact,32)||!save_receipt()||!same_authority())return 0;if(esp_ota_set_boot_partition(destination)!=ESP_OK)return 0;reboot_at=now_ms()+750;return 1;}
static int confirm_cb(void*unused,const uint8_t sid[16],const uint8_t artifact[32]){(void)unused;uint8_t id[32];if(!atomic_load(&pending_boot)||!receipt_ready||!same_authority()||!config.healthy||config.healthy()!=1||memcmp(sid,running_receipt.session,16)||!gb_crypto_hash(running_receipt.manifest,384,id)||memcmp(id,artifact,32))return 0;if(esp_ota_mark_app_valid_cancel_rollback()!=ESP_OK){atomic_store(&known_boot_state,255);return 0;}atomic_store(&known_boot_state,1);atomic_store(&confirmed_boot,true);atomic_store(&pending_boot,false);return 1;}
static void status_cb(void*unused,uint8_t b[1024]){(void)unused;const esp_partition_t*p=esp_ota_get_running_partition();b[256]=atomic_load(&pending_boot)?AO_PENDING:atomic_load(&confirmed_boot)?AO_CONFIRMED:AO_IDLE;b[258]=0;b[259]=1;b[260]=p&&p->subtype==ESP_PARTITION_SUBTYPE_APP_FACTORY?0:p&&p->subtype==ESP_PARTITION_SUBTYPE_APP_OTA_0?1:p&&p->subtype==ESP_PARTITION_SUBTYPE_APP_OTA_1?2:255;b[261]=(uint8_t)atomic_load(&known_boot_state);unsigned flags=(layout_ready()&&running_identity_ready?1:0)|(receipt_ready?2:0)|(config.healthy&&config.healthy()==1&&running_identity_ready&&(!atomic_load(&pending_boot)||receipt_ready)?4:0)|(link_credentials_load()?8:0);
#if CONFIG_AUMANET_PRIVATE_BOOTSTRAP
 flags|=16;
#endif
 b[262]=(uint8_t)(flags>>8);b[263]=(uint8_t)flags;put32(b+264,running_bytes);put32(b+268,p?p->address:0);put32(b+276,AO_SLOT_BYTES);memcpy(b+328,running_hash,32);if(receipt_ready){memcpy(b+280,running_receipt.session,16);gb_crypto_hash(running_receipt.manifest,384,b+296);memcpy(b+360,running_receipt.manifest,384);}memcpy(b+744,gateway_ota_build.version,32);memcpy(b+776,gateway_ota_build.commit,20);memcpy(b+796,gateway_ota_build.ref,128);memcpy(b+924,gateway_ota_build.build,64);memcpy(b+988,gateway_ota_build.profile,32);}
static void load_receipt(void){nvs_handle_t h;size_t n=sizeof running_receipt;const esp_partition_t*p=esp_ota_get_running_partition();esp_image_metadata_t metadata={0};if(p){esp_partition_pos_t pos={.offset=p->address,.size=p->size};if(esp_image_verify(ESP_IMAGE_VERIFY_SILENT,&pos,&metadata)==ESP_OK&&metadata.image_len<=p->size){running_bytes=metadata.image_len;running_identity_ready=partition_hash(p,running_bytes,running_hash);if(!running_identity_ready){running_bytes=0;memset(running_hash,0,32);}}}const char*key=p?receipt_key(p->address):NULL;if(!key||nvs_open("amn_update1",NVS_READONLY,&h)!=ESP_OK)return;esp_err_t e=nvs_get_blob(h,key,&running_receipt,&n);nvs_close(h);receipt_ready=e==ESP_OK&&n==sizeof running_receipt&&running_receipt.version==1&&p&&p->address==running_receipt.offset&&running_receipt.signature_bytes>=8&&running_receipt.signature_bytes<=72&&ao_manifest_checked(running_receipt.manifest,config.role)&&publisher_verify(NULL,running_receipt.manifest,384,running_receipt.signature,running_receipt.signature_bytes)&&partition_hash(p,u32(running_receipt.manifest+16),running_hash)&&!memcmp(running_hash,running_receipt.manifest+40,32);if(receipt_ready)running_bytes=u32(running_receipt.manifest+16);}
static void boot_watchdog(void*unused){(void)unused;uint64_t first=now_ms();for(;;){if(atomic_load(&pending_boot)&&now_ms()-first>=90000){esp_ota_mark_app_invalid_rollback_and_reboot();esp_restart();}vTaskDelay(pdMS_TO_TICKS(100));}}
void gateway_ota_boot(void){const esp_partition_t*p=esp_ota_get_running_partition();if(!p){esp_restart();return;}if(p->subtype==ESP_PARTITION_SUBTYPE_APP_FACTORY){atomic_store(&known_boot_state,0);return;}esp_ota_img_states_t state;if(esp_ota_get_state_partition(p,&state)!=ESP_OK){esp_restart();return;}if(state==ESP_OTA_IMG_VALID){atomic_store(&known_boot_state,1);return;}if(state!=ESP_OTA_IMG_PENDING_VERIFY){esp_restart();return;}atomic_store(&known_boot_state,2);atomic_store(&pending_boot,true);if(xTaskCreate(boot_watchdog,"ota_boot_guard",4096,NULL,5,NULL)!=pdPASS)esp_restart();}
/* Relay admission remains owner-signed; encrypted payloads are opaque and may
 * only follow the exact signed S session/endpoints for at most30min. */
struct relay_state {struct sockaddr_in owner,query_owner;uint8_t challenge[32],session[16];uint64_t query_at,session_at;bool query,active;};
static struct relay_state relay;
static int same_endpoint(const struct sockaddr_in*a,const struct sockaddr_in*b){return a->sin_addr.s_addr==b->sin_addr.s_addr&&a->sin_port==b->sin_port;}
static int relay_packet(const uint8_t*p,size_t n,int kind,const struct sockaddr_in*source,uint64_t now,struct sockaddr_in*to){if(config.role!=1||memcmp(p,config.peer,16)||!current(NULL))return 0;uint32_t ip=ntohl(source->sin_addr.s_addr);const uint8_t*b=p+16;
 if(ip==config.phone_ip){if(kind=='E'){if(!relay.active||now<relay.session_at||now-relay.session_at>=AO_SESSION_MS||memcmp(b+8,relay.session,16)||!same_endpoint(source,&relay.owner))return 0;}else{if(kind!='Q'&&kind!='S'&&kind!='C')return 0;size_t z=kind=='Q'?AO_QUERY:kind=='S'?AO_START:AO_COMMAND;static const uint8_t d[]="AuMaNET node OTA v1";uint8_t signed_bytes[sizeof d+AO_START];if(memcmp(b+32,config.group,16)||memcmp(b+56,config.owner_pin,32)||memcmp(b+88,config.node,16))return 0;uint64_t epoch=0;for(unsigned i=0;i<8;i++)epoch=epoch*256+b[48+i];if(epoch!=config.epoch)return 0;memcpy(signed_bytes,d,sizeof d);memcpy(signed_bytes+sizeof d,b,z);if(!owner_verify(NULL,signed_bytes,sizeof d+z,b+z+1,b[z]))return 0;relay.query_owner=*source;memcpy(relay.challenge,b+104,32);relay.query_at=now;relay.query=true;if(kind=='S'){uint8_t h[32];if(!gb_crypto_hash(b,z,h))return 0;memcpy(relay.session,h,16);relay.session_at=now;relay.owner=*source;relay.active=true;}}
  memset(to,0,sizeof *to);to->sin_family=AF_INET;to->sin_port=htons(AO_PORT);to->sin_addr.s_addr=htonl(config.peer_ip);return 1;}
 if(ip==config.peer_ip&&ntohs(source->sin_port)==AO_PORT){if(kind=='E'){if(!relay.active||now<relay.session_at||now-relay.session_at>=AO_SESSION_MS||memcmp(b+8,relay.session,16))return 0;*to=relay.owner;return 1;}if(kind=='R'&&relay.query&&now>=relay.query_at&&now-relay.query_at<AO_CHALLENGE_MS&&!memcmp(b+104,relay.challenge,32)){*to=relay.query_owner;return 1;}}return 0;}
static void worker(void*unused){(void)unused;uint8_t packet[AO_MAX_FRAME+1],reply[AO_MAX_FRAME];unsigned count=0,signed_count=0;uint32_t generation=generation_cb(NULL);uint64_t second=now_ms()/1000;for(;;){uint64_t now=now_ms();ao_tick(&engine,now);if(!current(NULL)||generation!=generation_cb(NULL)){memset(&relay,0,sizeof relay);generation=generation_cb(NULL);}if(reboot_at&&now>=reboot_at)esp_restart();struct sockaddr_in source; socklen_t z=sizeof source;int n=recvfrom(udp,packet,sizeof packet,0,(struct sockaddr*)&source,&z);if(n<0)continue;if(z!=sizeof source||source.sin_family!=AF_INET)continue;if(now/1000!=second){second=now/1000;count=signed_count=0;}if(++count>32)continue;int kind=ao_frame_kind(packet,(size_t)n);if(!kind||(kind!='E'&&++signed_count>2))continue;struct sockaddr_in to;if(relay_packet(packet,(size_t)n,kind,&source,now,&to)&&same_authority()){sendto(udp,packet,(size_t)n,0,(struct sockaddr*)&to,sizeof to);continue;}if(memcmp(packet,config.node,16)||ntohl(source.sin_addr.s_addr)!=(config.role==1?config.phone_ip:config.peer_ip)||(config.role==2&&ntohs(source.sin_port)!=AO_PORT))continue;size_t bytes=0;if(ao_receive(&engine,packet,(size_t)n,now,reply,&bytes)&&bytes&&same_authority())sendto(udp,reply,bytes,0,(struct sockaddr*)&source,sizeof source);}}
int gateway_ota_start(const struct gateway_ota_config*c){if(started)return 0;if(!c||!c->current||!c->healthy||!c->generation||!layout_ready())return 0;config=*c;load_receipt();mbedtls_ecp_keypair_init(&ephemeral_key);struct ao_port p={.current=current,.now=now_cb,.generation=generation_cb,.random=random_cb,.hash=hash_cb,.owner_verify=owner_verify,.publisher_verify=publisher_verify,.sign=sign_cb,.ephemeral=ephemeral_cb,.derive=derive_cb,.gcm=gcm_cb,.begin=begin_cb,.write=write_cb,.finish=finish_cb,.abort=abort_cb,.activate=activate_cb,.confirm=confirm_cb,.status=status_cb};if(!ao_initialize(&engine,&p,config.node,config.group,config.epoch,config.owner_pin,config.relay,config.run,config.role))return 0;udp=socket(AF_INET,SOCK_DGRAM,IPPROTO_UDP);if(udp<0)return 0;struct timeval wait={.tv_sec=0,.tv_usec=100000};struct sockaddr_in address={.sin_family=AF_INET,.sin_port=htons(AO_PORT),.sin_addr={.s_addr=INADDR_ANY}};if(setsockopt(udp,SOL_SOCKET,SO_RCVTIMEO,&wait,sizeof wait)<0||bind(udp,(struct sockaddr*)&address,sizeof address)<0||xTaskCreate(worker,"node_ota",16384,NULL,3,NULL)!=pdPASS){close(udp);udp=-1;return 0;}started=true;return 1;}

int gateway_ota_usb_status(int argc,char**argv){
 (void)argv;if(argc!=1)return 1;const esp_partition_t*p=esp_ota_get_running_partition();esp_ota_img_states_t state=ESP_OTA_IMG_UNDEFINED;esp_err_t result=p?esp_ota_get_state_partition(p,&state):ESP_FAIL;
 const char*partition=p&&p->subtype==ESP_PARTITION_SUBTYPE_APP_FACTORY?"factory":p&&p->subtype==ESP_PARTITION_SUBTYPE_APP_OTA_0?"ota0":p&&p->subtype==ESP_PARTITION_SUBTYPE_APP_OTA_1?"ota1":"unknown";
 flockfile(stdout);printf("\n{\"schema\":\"aumanet.node-update-status.v1\",\"version\":\"%s\",\"buildId\":\"%s\",\"partition\":\"%s\",\"partitionOffset\":%lu,\"bootState\":%d,\"pendingVerification\":%s,\"receiptKnown\":%s,\"privateBootstrap\":%s,\"imageBytes\":%lu,\"imageSha256\":",gateway_ota_build.version,gateway_ota_build.build,partition,(unsigned long)(p?p->address:0),result==ESP_OK?(int)state:-1,result==ESP_OK&&state==ESP_OTA_IMG_PENDING_VERIFY?"true":"false",receipt_ready?"true":"false",gateway_ota_build.private_bootstrap?"true":"false",(unsigned long)running_bytes);
 if(running_bytes){putchar('"');for(unsigned i=0;i<32;i++)printf("%02x",running_hash[i]);putchar('"');}else printf("null");const esp_partition_t*invalid=esp_ota_get_last_invalid_partition();printf(",\"lastInvalidPartitionOffset\":%lu}\n",(unsigned long)(invalid?invalid->address:0));funlockfile(stdout);return 0;
}
